## conf/distro/a1linux.conf
```bitbake
# Distribution definition for: a1linux
#
# Copyright (c) 2024 Boerge Struempfel <boerge.struempfel@gmail.com>
#
# The a1linux distribution is intended to define a Linux system
# trimmed down to work well with AutomationOne boards.

DISTRO = "a1linux"
DISTRO_NAME = "AutomationOne Linux Distribution"
DISTRO_VERSION = "1.0.0"
DISTRO_CODENAME = "alpha"

MAINTAINER = "Boerge Struempfel <boerge.struempfel@gmail.com>"

TARGET_VENDOR = "-a1linux"

LOCALCONF_VERSION = "2"

DISTRO_VERSION[vardepsexclude] = "DATE"
SDK_VERSION[vardepsexclude] = "DATE"

DISTRO_FEATURES = "3g bluetooth ipv4 ppp systemd usrmerge vfat wifi xattr"
DISTRO_FEATURES_BACKFILL_CONSIDERED += "sysvinit"
VIRTUAL-RUNTIME_init_manager = "systemd"

SDK_NAME = "${DISTRO}-${TCLIBC}-${SDK_ARCH}-${IMAGE_BASENAME}-${TUNE_PKGARCH}"
SDKPATH = "/opt/${DISTRO}/${SDK_VERSION}"

DISTRO_EXTRA_RDEPENDS += " packagegroup-core-boot "

TCLIBCAPPEND = ""

PREMIRRORS ??= "\
bzr://.*/.*   http://downloads.yoctoproject.org/mirror/sources/ \n \
cvs://.*/.*   http://downloads.yoctoproject.org/mirror/sources/ \n \
git://.*/.*   http://downloads.yoctoproject.org/mirror/sources/ \n \
gitsm://.*/.* http://downloads.yoctoproject.org/mirror/sources/ \n \
hg://.*/.*    http://downloads.yoctoproject.org/mirror/sources/ \n \
osc://.*/.*   http://downloads.yoctoproject.org/mirror/sources/ \n \
p4://.*/.*    http://downloads.yoctoproject.org/mirror/sources/ \n \
svn://.*/.*   http://downloads.yoctoproject.org/mirror/sources/ \n"

MIRRORS =+ "\
ftp://.*/.*      http://downloads.yoctoproject.org/mirror/sources/ \n \
http://.*/.*     http://downloads.yoctoproject.org/mirror/sources/ \n \
https://.*/.*    http://downloads.yoctoproject.org/mirror/sources/ \n"

# The CONNECTIVITY_CHECK_URI's are used to test whether we can succesfully
# fetch from the network (and warn you if not). To disable the test set
# the variable to be empty.
# Git example url: git://git.yoctoproject.org/yocto-firewall-test;protocol=git;rev=master
CONNECTIVITY_CHECK_URIS ?= "https://www.example.com/"

SANITY_TESTED_DISTROS ?= " \
            debian-10 \n \
            debian-11 \n \
            debian-12 \n \
            fedora-40 \n \
            "
#
# OELAYOUT_ABI allows us to notify users when the format of TMPDIR changes in
# an incompatible way. Such changes should usually be detailed in the commit
# that breaks the format and have been previously discussed on the mailing list
# with general agreement from the core team.
#
OELAYOUT_ABI = "12"

# QA check settings - a little stricter than the OE-Core defaults
WARN_TO_ERROR_QA = "already-stripped compile-host-path install-host-path \
                    installed-vs-shipped ldflags pn-overrides rpaths staticdev \
                    useless-rpaths"
WARN_QA:remove = "${WARN_TO_ERROR_QA}"
ERROR_QA:append = " ${WARN_TO_ERROR_QA}"

require conf/distro/include/no-static-libs.inc
require conf/distro/include/yocto-uninative.inc
INHERIT += "uninative"
```

## conf/layer.conf
```bitbake
# We have a conf and classes directory, add to BBPATH
BBPATH .= ":${LAYERDIR}"

# We have a packages directory, add to BBFILES
BBFILES += "${LAYERDIR}/recipes-*/*/*.bb"
BBFILES += "${LAYERDIR}/recipes-*/*/*.bbappend"

BBFILE_COLLECTIONS += "meta-a1-gw-extras"
BBFILE_PATTERN_meta-a1-gw-extras = "^${LAYERDIR}/"
BBFILE_PRIORITY_meta-a1-gw-extras = "5"

LAYERDEPENDS_meta-a1-gw-extras = "core"
LAYERSERIES_COMPAT_meta-a1-gw-extras = "scarthgap"

BBFILES_DYNAMIC += " \
  rauc:${LAYERDIR}/dynamic-layers/rauc/*/*/*.bb \
	rauc:${LAYERDIR}/dynamic-layers/rauc/*/*/*.bbappend \
"
```

## conf/machine/a1-imx6ull-gw-extra.conf
```bitbake
### Settings for ETC-Overlayfs
OVERLAYFS_ETC_MOUNT_POINT ?= "/data"
OVERLAYFS_ETC_DEVICE ?= "ubi0:data"
OVERLAYFS_ETC_FSTYPE ?= "ubifs"
OVERLAYFS_ETC_USE_ORIG_INIT_NAME = "0"
OVERLAYFS_ETC_CREATE_MOUNT_DIRS = "0"
```
